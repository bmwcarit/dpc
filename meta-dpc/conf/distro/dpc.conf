## meta-dpc/conf/distro/dpc.conf
```bitbake
# base this distro on the yocto standard distro "poky"
require conf/distro/poky.conf

DISTRO_NAME = "Dependable Power Computing distribution"
DISTRO_VERSION = "0.1"

# select systemd as our initialization manager
DISTRO_FEATURES_append = " systemd"
VIRTUAL-RUNTIME_init_manager = "systemd"
DISTRO_FEATURES_BACKFILL_CONSIDERED = "sysvinit"
```

## meta-dpc/conf/layer.conf
```bitbake
# We have a conf and classes directory, add to BBPATH
BBPATH .= ":${LAYERDIR}"

# We have recipes-* directories, add to BBFILES
BBFILES += "${LAYERDIR}/recipes-*/*/*.bb \
        ${LAYERDIR}/recipes-*/*/*.bbappend"

BBFILE_COLLECTIONS += "dpc"
BBFILE_PATTERN_dpc = "^${LAYERDIR}/"
BBFILE_PRIORITY_dpc = "6"
```
